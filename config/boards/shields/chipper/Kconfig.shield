## config/boards/shields/chipper/Kconfig.shield
```kconfig
# Copyright (c) 2020 Pete Johanson
# SPDX-License-Identifier: MIT

config SHIELD_JIJIMON_LEFT
	def_bool $(shields_list_contains,jijimon_left)

config SHIELD_JIJIMON_RIGHT
	def_bool $(shields_list_contains,jijimon_right)
```
